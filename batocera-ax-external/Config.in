## batocera-ax-external/Config.in
```kconfig
menu "Piccolo [AX] Console Appliance"

menu "1. Core Runtime, Bootloader & Acceleration"

config BR2_PACKAGE_AX_SDK
	bool "ax-sdk (libax_core)"
	default y
	help
	  Shared dependency-free C++20 deterministic hardware runtime
	  for The Silicon Preservation Society emulators.

config BR2_PACKAGE_LIMINE
	bool "Limine Bootloader (UEFI / BIOS)"
	depends on BR2_x86_64
	default y
	help
	  Deterministic UEFI/BIOS bootloader for Piccolo [AX] mode-isolated
	  boot entries (ax.mode=audio|upscaler|retro|desktop).

config BR2_PACKAGE_LSFG_VK
	bool "lsfg-vk 2.0.0+ (Implicit Vulkan Frame Generation)"
	default y
	help
	  Vulkan 1.2 bindless FP32 frame-generation layer (requires user-supplied
	  Lossless.dll placed in /userdata/system/lsfg/Lossless.dll).

config BR2_PACKAGE_VMTOUCH
	bool "vmtouch (MAP_POPULATE RAM Asset Pinner)"
	default y
	help
	  Bulk pre-faults filtered game containers into DDR4 RAM (-dql).

endmenu

menu "2. AX Console & Classic Engines"

config BR2_PACKAGE_EDEN_AX
	bool "Eden Espresso Wave [AX] (Nintendo Switch)"
	depends on BR2_PACKAGE_AX_SDK
	default y
	select BR2_PACKAGE_QT6
	select BR2_PACKAGE_QT6BASE
	select BR2_PACKAGE_QT6BASE_GUI
	select BR2_PACKAGE_QT6BASE_WIDGETS
	select BR2_PACKAGE_QT6BASE_OPENGL
	select BR2_PACKAGE_QT6BASE_VULKAN
	select BR2_PACKAGE_QT6SVG
	select BR2_PACKAGE_QT6WEBSOCKETS
	help
	  Deterministic Nintendo Switch emulator compiled with standalone
	  Clang 23.1+ (ThinLTO + 3-Phase PGO) and linked against ax-sdk.

config BR2_PACKAGE_CEMU_LATTE_AX
	bool "Cemu Latte [AX] (Nintendo Wii U)"
	depends on BR2_PACKAGE_AX_SDK
	default y
	select BR2_PACKAGE_QT6
	select BR2_PACKAGE_QT6BASE
	select BR2_PACKAGE_QT6BASE_GUI
	select BR2_PACKAGE_QT6BASE_WIDGETS
	select BR2_PACKAGE_QT6BASE_OPENGL
	select BR2_PACKAGE_QT6BASE_VULKAN
	select BR2_PACKAGE_QT6SVG
	select BR2_PACKAGE_QT6WEBSOCKETS
	help
	  Deterministic Nintendo Wii U emulator compiled with standalone
	  Clang 23.1+ (ThinLTO + 3-Phase PGO) and linked against ax-sdk.

config BR2_PACKAGE_RMG_AX
	bool "RMG-Mupen [AX] (Nintendo 64)"
	depends on BR2_PACKAGE_AX_SDK
	default y
	select BR2_PACKAGE_QT6
	select BR2_PACKAGE_QT6BASE
	select BR2_PACKAGE_QT6BASE_GUI
	select BR2_PACKAGE_QT6BASE_WIDGETS
	select BR2_PACKAGE_QT6BASE_OPENGL
	select BR2_PACKAGE_QT6BASE_VULKAN
	select BR2_PACKAGE_QT6SVG
	select BR2_PACKAGE_QT6WEBSOCKETS
	select BR2_PACKAGE_SDL3
	select BR2_PACKAGE_LIBSAMPLERATE
	select BR2_PACKAGE_SPEEXDSP
	select BR2_PACKAGE_LIBUSB
	select BR2_PACKAGE_HIDAPI
	select BR2_PACKAGE_MINIZIP
	select BR2_PACKAGE_FREETYPE
	select BR2_PACKAGE_VULKAN_HEADERS
	help
	  Deterministic Nintendo 64 emulator (Rosalie's Mupen GUI) linked against ax-sdk.

config BR2_PACKAGE_CANNONBALL_AX
	bool "Cannonball-OutRun [AX] (Sega Arcade)"
	depends on BR2_PACKAGE_AX_SDK
	default y
	select BR2_PACKAGE_BOOST
	select BR2_PACKAGE_SDL2
	help
	  Deterministic Sega OutRun C++ arcade engine linked against ax-sdk.

config BR2_PACKAGE_FRONTIER_AX
	bool "Frontier: Elite II [AX] (Atari ST 68k-to-C)"
	depends on BR2_PACKAGE_AX_SDK
	default y
	select BR2_PACKAGE_SDL2
	select BR2_PACKAGE_LIBGLU
	help
	  Deterministic 1993 Atari ST Frontier: Elite II engine linked against ax-sdk.

config BR2_PACKAGE_BLASTEM_AX
	bool "BlastEm-MegaDrive [AX] (Sega Mega Drive / YM2612)"
	depends on BR2_PACKAGE_AX_SDK
	default y
	select BR2_PACKAGE_SDL2
	select BR2_PACKAGE_LIBGLEW
	help
	  Cycle-accurate Sega Mega Drive / Genesis engine (YM2612 FM + 68k/Z80 JIT) linked against ax-sdk.

config BR2_PACKAGE_FLYCAST_AX
	bool "Flycast [AX] (Sega Dreamcast / NAOMI / Atomiswave)"
	depends on BR2_PACKAGE_AX_SDK
	default y
	select BR2_PACKAGE_SDL2
	select BR2_PACKAGE_ALSA_LIB
	select BR2_PACKAGE_LIBCURL
	select BR2_PACKAGE_VULKAN_HEADERS
	select BR2_PACKAGE_VULKAN_LOADER
	select BR2_PACKAGE_LIBZIP
	help
	  Deterministic Sega Dreamcast, NAOMI & Atomiswave engine linked against ax-sdk.

config BR2_PACKAGE_HATARI_AX
	bool "Hatari [AX] (Atari ST / STE / TT / Falcon)"
	depends on BR2_PACKAGE_AX_SDK
	default y
	select BR2_PACKAGE_SDL2
	select BR2_PACKAGE_ALSA_LIB
	select BR2_PACKAGE_LIBPNG
	help
	  Cycle-accurate Atari ST/STE/TT/Falcon emulator with ALSA MIDI and ax-sdk audio ring.

if BR2_EXTERNAL_PICCOLO_AX_PATH != ""
	source "$BR2_EXTERNAL_PICCOLO_AX_PATH/package/amiberry-ax/Config.in"
	source "$BR2_EXTERNAL_PICCOLO_AX_PATH/package/genx-snes-ax/Config.in"
endif

endmenu

menu "3. FLAC_AX Audio/Visual Studio & Upscaler"

if BR2_EXTERNAL_PICCOLO_AX_PATH != ""
	source "$BR2_EXTERNAL_PICCOLO_AX_PATH/package/flac-ax/Config.in"
endif

endmenu

menu "4. Optional Desktop Workbench (piccolo-ax-desktop)"

config BR2_PACKAGE_PICCOLO_AX_DESKTOP
	bool "Piccolo-AX Desktop Workbench Layer (Opt-in < 42 MB C/C++ Suite)"
	default n
	help
	  Optional on-demand C/C++ desktop workbench (LXQt/XFCE, PCManFM-Qt,
	  Worker, Falkon, GrafX2, LibreSprite, mtPaint, AzPainter, MilkyTracker,
	  mhWaveEdit, QASMixer, GHex, CPU-X, nvtop, htop) with SHARE persistence.

if BR2_PACKAGE_PICCOLO_AX_DESKTOP
	if BR2_EXTERNAL_PICCOLO_AX_DESKTOP_PATH != ""
		source "$BR2_EXTERNAL_PICCOLO_AX_DESKTOP_PATH/buildroot/Config.in"
	endif
	if BR2_EXTERNAL_PICCOLO_AX_DESKTOP_PATH = "" && BR2_EXTERNAL_PICCOLO_AX_PATH != ""
		source "$BR2_EXTERNAL_PICCOLO_AX_PATH/../../piccolo-ax-desktop/buildroot/Config.in"
	endif
endif

endmenu

endmenu
```

## batocera-ax-external/package/amiberry-ax/Config.in
```kconfig
config BR2_PACKAGE_AMIBERRY_AX
	bool "Amiberry [AX] (Commodore Amiga 500 / 1200 / CD32)"
	depends on BR2_INSTALL_LIBSTDCPP
	depends on BR2_TOOLCHAIN_HAS_THREADS
	select BR2_PACKAGE_AX_SDK
	select BR2_PACKAGE_SDL2
	select BR2_PACKAGE_SDL2_IMAGE
	select BR2_PACKAGE_SDL2_TTF
	select BR2_PACKAGE_FLAC
	select BR2_PACKAGE_LIBMPG123
	select BR2_PACKAGE_LIBPNG
	select BR2_PACKAGE_LIBXML2
	select BR2_PACKAGE_ZLIB
	help
	  Deterministic Commodore Amiga (OCS/ECS/AGA, A500/A1200/CD32) engine
	  compiled with standalone Clang 23.1+ (ThinLTO) and linked against ax-sdk.
```

## batocera-ax-external/package/ax-sdk/Config.in
```kconfig
config BR2_PACKAGE_AX_SDK
	bool "ax-sdk"
	help
	  Shared C++20 Deterministic Emulation Core (libax_core).
	  https://github.com
```

## batocera-ax-external/package/cemu-latte-ax/Config.in
```kconfig
config BR2_PACKAGE_CEMU_LATTE_AX
	bool "cemu-latte-ax"
	select BR2_PACKAGE_AX_SDK
	help
	  Cemu Latte [AX] Nintendo Wii U Emulator.
	  https://github.com
```

## batocera-ax-external/package/eden-ax/Config.in
```kconfig
config BR2_PACKAGE_EDEN_AX
	bool "eden-ax"
	select BR2_PACKAGE_AX_SDK
	help
	  Eden Espresso Wave [AX] Nintendo Switch Emulator.
	  https://github.com
```

## batocera-ax-external/package/flac-ax/Config.in
```kconfig
config BR2_PACKAGE_FLAC_AX
	bool "FLAC_AX & [AX] Audio/Visual Appliance Suite"
	depends on BR2_INSTALL_LIBSTDCPP
	depends on BR2_TOOLCHAIN_HAS_THREADS
	select BR2_PACKAGE_AX_SDK
	select BR2_PACKAGE_FLAC
	select BR2_PACKAGE_ALSA_LIB
	help
	  Deterministic [AX] bit-perfect S32_LE & DoP (DSD64/DSD128) audio
	  transport (flac_ax) with multi-DAC USB isolation rules.

if BR2_PACKAGE_FLAC_AX

config BR2_PACKAGE_FLAC_AX_AV_STUDIO
	bool "Build ax_av_studio (MPK Mini MK3 + Synth + OpenGL HUD)"
	default y
	select BR2_PACKAGE_SDL2
	help
	  2.00 ms 16-voice polyphonic subtractive + 8-voice drum synthesizer,
	  Schroeder reverb, tape delay, and VBlank-locked OpenGL HUD.

config BR2_PACKAGE_FLAC_AX_VIDEO_UPSCALER
	bool "Build ax_video_upscaler (720p/1080p/2K V4L2 & DVD upscaler)"
	default y
	help
	  Single-stream 720p/1080p/2K retro HDMI capture (MS2130S) and DVD
	  upscaler synchronized to the DAC master sample clock.

config BR2_PACKAGE_FLAC_AX_APPLIANCE_TUI
	bool "Build ax_appliance_tui (Core 5 Espresso Appliance Launcher)"
	default y
	help
	  Zero-dependency 24-bit ANSI Coffee/Espresso TUI launcher pinned
	  to Core 5 (0x20) with live DAC lock and RAM telemetry.

config BR2_PACKAGE_FLAC_AX_USB_DAC_RULES
	bool "Install 99-ax-usb-dacs.rules (HiBy FC3, KA11, Black Pearl, Dawn Pro 2, Apple)"
	default y
	help
	  Installs udev rules bypassing PulseAudio/PipeWire ACP claiming and
	  disabling USB autosuspend for supported UAC 2.0 USB-C DACs.

endif
```

## batocera-ax-external/package/frontier-ax/Config.in
```kconfig
config BR2_PACKAGE_FRONTIER_AX
	bool "frontier-ax"
	depends on BR2_PACKAGE_AX_SDK
	select BR2_PACKAGE_SDL2
	help
	  Frontier: Elite II (glfrontier) package for Piccolo-AX.
```

## batocera-ax-external/package/genx-snes-ax/Config.in
```kconfig
config BR2_PACKAGE_GENX_SNES_AX
	bool "genx-snes-ax"
	depends on BR2_PACKAGE_AX_SDK
	default y
	help
	  Deterministic SNES engine adapter (Generation-X-AX) for Piccolo-AX
	  with 2:3:1 topology, /dev/shm staging, /run/lock/ax-dac.lock audio
	  arbitration, and atomic save/SRAM flush.
```

## batocera-ax-external/package/limine/Config.in
```kconfig
config BR2_PACKAGE_LIMINE
	bool "limine"
	depends on BR2_x86_64
	help
	  Deterministic UEFI/BIOS bootloader for Piccolo [AX] mode-isolated
	  boot entries (ax.mode=audio|upscaler|retro|desktop).
```

## batocera-ax-external/package/rmg-ax/Config.in
```kconfig
config BR2_PACKAGE_RMG_AX
	bool "rmg-ax"
	depends on BR2_PACKAGE_QT6
	select BR2_PACKAGE_QT6BASE_GUI
	select BR2_PACKAGE_QT6BASE_WIDGETS
	select BR2_PACKAGE_QT6BASE_OPENGL
	select BR2_PACKAGE_QT6BASE_VULKAN
	select BR2_PACKAGE_QT6SVG
	select BR2_PACKAGE_QT6WEBSOCKETS
	select BR2_PACKAGE_SDL3
	select BR2_PACKAGE_LIBSAMPLERATE
	select BR2_PACKAGE_SPEEXDSP
	select BR2_PACKAGE_LIBUSB
	select BR2_PACKAGE_HIDAPI
	select BR2_PACKAGE_MINIZIP
	select BR2_PACKAGE_FREETYPE
	select BR2_PACKAGE_VULKAN_HEADERS
	help
	  Rosalie's Mupen GUI (RMG) [AX] — Nintendo 64 emulator wired to
	  ax-sdk for deterministic core isolation, HugeTLB fastmem,
	  and lock-free real-time USB DAC audio on Piccolo [AX].
```
